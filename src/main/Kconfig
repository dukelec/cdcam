## src/sdkconfig.defaults
```kconfig
CONFIG_IDF_TARGET="esp32p4"
CONFIG_SPIRAM=y
CONFIG_IDF_EXPERIMENTAL_FEATURES=y
CONFIG_SPIRAM_SPEED_200M=y
CONFIG_CAMERA_OV5647=y
CONFIG_PARTITION_TABLE_OFFSET=0x10000

CONFIG_ESPTOOLPY_FLASHSIZE_4MB=y
CONFIG_ESPTOOLPY_FLASHSIZE="4MB"

CONFIG_SPI_MASTER_IN_IRAM=y
CONFIG_ESP_SPI_BUS_LOCK_FUNCS_IN_IRAM=y

CONFIG_ESP_CONSOLE_UART_CUSTOM=y
CONFIG_ESP_CONSOLE_UART_BAUDRATE=2000000
CONFIG_ESP_CONSOLE_SECONDARY_NONE=y

CONFIG_LIBC_STDOUT_LINE_ENDING_LF=y
CONFIG_LIBC_STDIN_LINE_ENDING_LF=y

CONFIG_BOOTLOADER_WDT_TIME_MS=20000
```
